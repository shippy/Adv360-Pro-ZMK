## config/west.yml
```yaml
manifest:
  remotes:
    - name: zmkfirmware
      url-base: https://github.com/zmkfirmware
    - name: refil
      url-base: https://github.com/refil
    - name: urob
      url-base: https://github.com/urob

  projects:
    # - name: zmk
    #   remote: refil
    #   revision: adv360-z3.2-3
    #   import: app/west.yml
    - name: zmk
      remote: urob
      revision: main
      import: app/west.yml
  self:
    path: config
```
