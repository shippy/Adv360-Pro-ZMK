macro_cut_all: macro_cut_all{
    compatible = "zmk,behavior-macro";
    #binding-cells = <0>;
    bindings = <&kp LC(A)>, <&kp LC(X)>;
};
macro_cut_all_macos: macro_cut_all_macos{
    compatible = "zmk,behavior-macro";
    #binding-cells = <0>;
    bindings = <&kp LG(A)>, <&kp LG(X)>;
};
macro_simon: macro_simon{
    compatible = "zmk,behavior-macro";
    #binding-cells = <0>;
    bindings = <&kp LS(S)>, <&kp I>, <&kp M>, <&kp O>, <&kp N>;
};